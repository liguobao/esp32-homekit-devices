## main/Kconfig.projbuild
```kconfig
menu "Example Configuration"

    config EXAMPLE_USE_HARDCODED_SETUP_CODE
        bool "Use hard-coded setup code"
        default y
        help
            HomeKit does not recommend having the setup code programmed in the accessory as is.
            Instead, it expects setup info (salt-verifier pair) generated for the given setup code.
            Use this option only for testing purposes. For production, the setup info should be
            used.

    config EXAMPLE_SETUP_CODE
        string "HomeKit Setup Code"
        default "111-22-333"
        depends on EXAMPLE_USE_HARDCODED_SETUP_CODE
        help
            Setup code to be used for HomeKot pairing, if hard-coded setup code is enabled.

    config EXAMPLE_SETUP_ID
        string "HomeKit Setup Id"
        default "ES32"
        depends on EXAMPLE_USE_HARDCODED_SETUP_CODE
        help
            Setup id to be used for HomeKot pairing, if hard-coded setup code is enabled.

    menu "ST7789 Display Configuration"

        config HOMEKIT_ENABLE_ST7789_DISPLAY
            bool "Enable ST7789 SPI display"
            default n
            help
                Enable an optional ST7789 status screen. The display shows the
                accessory name, model, setup code, and live on/off state.

        if HOMEKIT_ENABLE_ST7789_DISPLAY

            config HOMEKIT_ST7789_PIN_SCLK
                int "SPI clock GPIO"
                default -1
                help
                    GPIO connected to the ST7789 SCL/SCLK pin.

            config HOMEKIT_ST7789_PIN_MOSI
                int "SPI MOSI GPIO"
                default -1
                help
                    GPIO connected to the ST7789 SDA/MOSI pin.

            config HOMEKIT_ST7789_PIN_CS
                int "SPI CS GPIO"
                default -1
                help
                    GPIO connected to the ST7789 CS pin.

            config HOMEKIT_ST7789_PIN_DC
                int "SPI DC GPIO"
                default -1
                help
                    GPIO connected to the ST7789 DC pin.

            config HOMEKIT_ST7789_PIN_RST
                int "Reset GPIO"
                default -1
                help
                    GPIO connected to the ST7789 RST pin. Set to -1 if the
                    module reset pin is tied high.

            config HOMEKIT_ST7789_PIN_BL
                int "Backlight GPIO"
                default -1
                help
                    GPIO connected to the display backlight control pin. Set to
                    -1 if the backlight is always on.

            config HOMEKIT_ST7789_BL_ACTIVE_HIGH
                bool "Backlight active high"
                default y
                help
                    Enable this when the backlight turns on with a high level.

            config HOMEKIT_ST7789_SPI_CLOCK_HZ
                int "SPI clock (Hz)"
                default 20000000
                help
                    Pixel clock used for the SPI panel I/O.

            config HOMEKIT_ST7789_H_RES
                int "Horizontal resolution"
                default 240
                help
                    Active display width in pixels.

            config HOMEKIT_ST7789_V_RES
                int "Vertical resolution"
                default 240
                help
                    Active display height in pixels.

            config HOMEKIT_ST7789_X_OFFSET
                int "X offset"
                default 0
                help
                    Horizontal panel gap, useful for modules where the visible
                    area is offset inside the controller frame buffer.

            config HOMEKIT_ST7789_Y_OFFSET
                int "Y offset"
                default 0
                help
                    Vertical panel gap, useful for modules where the visible
                    area is offset inside the controller frame buffer.

            config HOMEKIT_ST7789_SWAP_XY
                bool "Swap X/Y"
                default n
                help
                    Rotate the content by swapping the X and Y axes.

            config HOMEKIT_ST7789_MIRROR_X
                bool "Mirror X"
                default n
                help
                    Mirror the display content horizontally.

            config HOMEKIT_ST7789_MIRROR_Y
                bool "Mirror Y"
                default n
                help
                    Mirror the display content vertically.

            config HOMEKIT_ST7789_INVERT_COLORS
                bool "Invert colors"
                default y
                help
                    Some ST7789 modules require color inversion for correct
                    contrast. Disable this if colors look wrong.

            config HOMEKIT_ST7789_BGR_ORDER
                bool "Use BGR color order"
                default y
                help
                    Switch between RGB and BGR ordering. Disable this if red and
                    blue are swapped on your panel.

        endif

    endmenu

    menu "Dashboard Device Configuration"

        config HOMEKIT_DASHBOARD_LIGHT_ACTIVE_LOW
            bool "Dashboard light outputs are active low"
            default y
            help
                Keep this enabled when your relays or drivers turn on with a
                low output level.

        config HOMEKIT_DASHBOARD_LIGHT1_GPIO
            int "Dashboard light 1 GPIO"
            default 2
            help
                Output GPIO for the first HomeKit light.

        config HOMEKIT_DASHBOARD_LIGHT2_GPIO
            int "Dashboard light 2 GPIO"
            default 3
            help
                Output GPIO for the second HomeKit light.

        config HOMEKIT_DASHBOARD_LIGHT3_GPIO
            int "Dashboard light 3 GPIO"
            default 4
            help
                Output GPIO for the third HomeKit light.

        config HOMEKIT_DASHBOARD_SPI_SCLK
            int "Dashboard shared SPI clock GPIO"
            default 2
            help
                Shared SPI SCLK for both strip displays.

        config HOMEKIT_DASHBOARD_SPI_MOSI
            int "Dashboard shared SPI MOSI GPIO"
            default 3
            help
                Shared SPI MOSI/SDA for both strip displays.

        config HOMEKIT_DASHBOARD_SPI_CLOCK_HZ
            int "Dashboard SPI clock (Hz)"
            default 10000000
            help
                Shared SPI pixel clock used by panels on the hardware SPI bus.
                Right-side panels that use dedicated software SPI pins ignore
                this value.
                10 MHz is a safe default for most ST7789 and NV3007 strips;
                raise to 20000000 only if your panel supports it.

        menu "Left ST7789 Strip"

            config HOMEKIT_DASHBOARD_LEFT_CS
                int "Left ST7789 CS GPIO"
                default 7

            config HOMEKIT_DASHBOARD_LEFT_DC
                int "Left ST7789 DC GPIO"
                default 6

            config HOMEKIT_DASHBOARD_LEFT_SCLK
                int "Left panel dedicated SCLK GPIO (-1 = share dashboard SPI bus)"
                default 2
                help
                    Set to a valid GPIO to use an independent software-SPI clock
                    for the left panel. Leave at -1 to share the dashboard SPI bus.

            config HOMEKIT_DASHBOARD_LEFT_MOSI
                int "Left panel dedicated MOSI GPIO (-1 = share dashboard SPI bus)"
                default 3
                help
                    Set to a valid GPIO to use an independent software-SPI data
                    pin for the left panel. Leave at -1 to share the dashboard SPI bus.

            config HOMEKIT_DASHBOARD_LEFT_RST
                int "Left ST7789 reset GPIO"
                default 10

            config HOMEKIT_DASHBOARD_LEFT_BL
                int "Left ST7789 backlight GPIO"
                default -1

            config HOMEKIT_DASHBOARD_LEFT_BL_ACTIVE_HIGH
                bool "Left ST7789 backlight active high"
                default y

            config HOMEKIT_DASHBOARD_LEFT_H_RES
                int "Left ST7789 width"
                default 76

            config HOMEKIT_DASHBOARD_LEFT_V_RES
                int "Left ST7789 height"
                default 284

            config HOMEKIT_DASHBOARD_LEFT_X_OFFSET
                int "Left ST7789 X offset"
                default 18

            config HOMEKIT_DASHBOARD_LEFT_Y_OFFSET
                int "Left ST7789 Y offset"
                default 82

            config HOMEKIT_DASHBOARD_LEFT_SWAP_XY
                bool "Left ST7789 swap X/Y"
                default y

            config HOMEKIT_DASHBOARD_LEFT_MIRROR_X
                bool "Left ST7789 mirror X"
                default n

            config HOMEKIT_DASHBOARD_LEFT_MIRROR_Y
                bool "Left ST7789 mirror Y"
                default y

            config HOMEKIT_DASHBOARD_LEFT_INVERT_COLORS
                bool "Left ST7789 invert colors"
                default n

            config HOMEKIT_DASHBOARD_LEFT_BGR_ORDER
                bool "Left ST7789 use BGR order"
                default y

        endmenu

        choice HOMEKIT_DASHBOARD_RIGHT_PANEL_TYPE
            prompt "Right panel controller"
            default HOMEKIT_DASHBOARD_RIGHT_PANEL_ST7789
            help
                Select the controller family used by the right-side dashboard panel.

            config HOMEKIT_DASHBOARD_RIGHT_PANEL_ST7789
                bool "ST7789/ST7899-compatible"

            config HOMEKIT_DASHBOARD_RIGHT_PANEL_NV3007
                bool "NV3007"

        endchoice

        menu "Right Display Strip"

            config HOMEKIT_DASHBOARD_RIGHT_CS
                int "Right panel CS GPIO"
                default 19 if HOMEKIT_DASHBOARD_RIGHT_PANEL_ST7789
                default 13

            config HOMEKIT_DASHBOARD_RIGHT_DC
                int "Right panel DC GPIO"
                default 18 if HOMEKIT_DASHBOARD_RIGHT_PANEL_ST7789
                default 14

            config HOMEKIT_DASHBOARD_RIGHT_SCLK
                int "Right panel dedicated SCLK GPIO (-1 = share dashboard SPI bus)"
                default 0 if HOMEKIT_DASHBOARD_RIGHT_PANEL_ST7789
                default -1
                help
                    Set to a valid GPIO to use an independent software-SPI clock
                    for the right panel. Leave at -1 to share the dashboard SPI bus.

            config HOMEKIT_DASHBOARD_RIGHT_MOSI
                int "Right panel dedicated MOSI GPIO (-1 = share dashboard SPI bus)"
                default 1 if HOMEKIT_DASHBOARD_RIGHT_PANEL_ST7789
                default -1
                help
                    Set to a valid GPIO to use an independent software-SPI data
                    pin for the right panel. Leave at -1 to share the dashboard SPI bus.

            config HOMEKIT_DASHBOARD_RIGHT_RST
                int "Right panel reset GPIO"
                default 12 if HOMEKIT_DASHBOARD_RIGHT_PANEL_ST7789
                default 15

            config HOMEKIT_DASHBOARD_RIGHT_BL
                int "Right panel backlight GPIO"
                default -1

            config HOMEKIT_DASHBOARD_RIGHT_BL_ACTIVE_HIGH
                bool "Right panel backlight active high"
                default y

            config HOMEKIT_DASHBOARD_RIGHT_H_RES
                int "Right panel width"
                default 76 if HOMEKIT_DASHBOARD_RIGHT_PANEL_ST7789
                default 142

            config HOMEKIT_DASHBOARD_RIGHT_V_RES
                int "Right panel height"
                default 284 if HOMEKIT_DASHBOARD_RIGHT_PANEL_ST7789
                default 428

            config HOMEKIT_DASHBOARD_RIGHT_X_OFFSET
                int "Right panel X offset"
                default 18 if HOMEKIT_DASHBOARD_RIGHT_PANEL_ST7789
                default 0

            config HOMEKIT_DASHBOARD_RIGHT_Y_OFFSET
                int "Right panel Y offset"
                default 82 if HOMEKIT_DASHBOARD_RIGHT_PANEL_ST7789
                default 0

            config HOMEKIT_DASHBOARD_RIGHT_SWAP_XY
                bool "Right panel swap X/Y"
                default y if HOMEKIT_DASHBOARD_RIGHT_PANEL_ST7789
                default n

            config HOMEKIT_DASHBOARD_RIGHT_MIRROR_X
                bool "Right panel mirror X"
                default y if HOMEKIT_DASHBOARD_RIGHT_PANEL_ST7789
                default n

            config HOMEKIT_DASHBOARD_RIGHT_MIRROR_Y
                bool "Right panel mirror Y"
                default n

            config HOMEKIT_DASHBOARD_RIGHT_INVERT_COLORS
                bool "Right panel invert colors"
                default n if HOMEKIT_DASHBOARD_RIGHT_PANEL_ST7789
                default n

            config HOMEKIT_DASHBOARD_RIGHT_BGR_ORDER
                bool "Right panel use BGR order"
                default y

        endmenu

        config HOMEKIT_DASHBOARD_TIMEZONE
            string "Dashboard timezone (TZ)"
            default "CST-8"
            help
                POSIX TZ string used for the left screen clock.

        config HOMEKIT_DASHBOARD_WEATHER_LOCATION
            string "Weather location slug"
            default ""
            help
                Optional wttr.in location, for example shanghai or beijing.
                Leave empty to let wttr.in infer location from the public IP.

        config HOMEKIT_DASHBOARD_WEATHER_REFRESH_SEC
            int "Weather refresh interval (seconds)"
            default 600
            range 60 86400
            help
                How often to refresh the weather string on the left screen.

    endmenu

endmenu
```

## sdkconfig.defaults
```kconfig
CONFIG_IDF_TARGET="esp32c3"
CONFIG_PARTITION_TABLE_CUSTOM=y
CONFIG_PARTITION_TABLE_CUSTOM_FILENAME="partitions_hap.csv"
CONFIG_FREERTOS_UNICORE=y
CONFIG_LWIP_MAX_SOCKETS=16
CONFIG_LWIP_SO_REUSE=y
CONFIG_LWIP_MAX_ACTIVE_TCP=12
CONFIG_LWIP_MAX_LISTENING_TCP=12
CONFIG_LWIP_UDP_RECVMBOX_SIZE=10
CONFIG_MBEDTLS_HARDWARE_MPI=y
CONFIG_ESP_TASK_WDT_INIT=n
CONFIG_LWIP_AUTOIP=y
CONFIG_ESPTOOLPY_FLASHSIZE_4MB=y
CONFIG_LWIP_AUTOIP_RATE_LIMIT_INTERVAL=60
CONFIG_BT_ENABLED=y
CONFIG_BT_NIMBLE_ENABLED=y
# CONFIG_APP_WIFI_USE_PROVISIONING is not set
CONFIG_APP_WIFI_USE_HARDCODED=y
CONFIG_EXAMPLE_USE_HARDCODED_SETUP_CODE=y
CONFIG_EXAMPLE_SETUP_CODE="111-22-333"
CONFIG_EXAMPLE_SETUP_ID="C3HK"
```

## sdkconfig.defaults.epaper
```kconfig
# Waveshare ESP32-S3-ePaper-1.54 V2 board defaults.
# The V2 board carries 8MB flash; keep the project image layout aligned.

# CONFIG_ESPTOOLPY_FLASHSIZE_4MB is not set
CONFIG_ESPTOOLPY_FLASHSIZE_8MB=y
CONFIG_ESPTOOLPY_FLASHSIZE="8MB"
CONFIG_PARTITION_TABLE_CUSTOM_FILENAME="partitions_hap_epaper.csv"
CONFIG_ESPTOOLPY_FLASHMODE_QIO=y
CONFIG_SPIRAM=y
CONFIG_SPIRAM_MODE_OCT=y
CONFIG_SPIRAM_SPEED_80M=y
CONFIG_FATFS_LFN_HEAP=y
```

## sdkconfig.defaults.local.epaper-v2.example
```kconfig
# Copy this file to sdkconfig.defaults.local for Waveshare ESP32-S3-ePaper-1.54 V2.
# V1 and V2 use different examples and are not compatible.

CONFIG_IDF_TARGET="esp32s3"
CONFIG_APP_WIFI_SSID="your-wifi-ssid"
CONFIG_APP_WIFI_PASSWORD="your-wifi-password"

# Optional overrides:
# CONFIG_HOMEKIT_EPAPER_REFRESH_INTERVAL_SEC=60
# CONFIG_HOMEKIT_EPAPER_TEMP_OFFSET_DECICELSIUS=-40
```

## sdkconfig.defaults.local.example
```kconfig
# Copy this file to sdkconfig.defaults.local and fill in your own Wi-Fi credentials.
# The sdkconfig.defaults.local file is ignored by git.
# For Waveshare ESP32-S3-ePaper-1.54 V2, use sdkconfig.defaults.local.epaper-v2.example instead.

CONFIG_APP_WIFI_SSID="your-wifi-ssid"
CONFIG_APP_WIFI_PASSWORD="your-wifi-password"
```
